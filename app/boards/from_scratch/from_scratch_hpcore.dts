/*
 * Copyright (c) 2023 Espressif Systems (Shanghai) Co., Ltd.
 *
 * SPDX-License-Identifier: Apache-2.0
 */

/dts-v1/;

#include <espressif/esp32c6/esp32c6_wroom_n8.dtsi>
#include "from_scratch_hpcore-pinctrl.dtsi"
#include <espressif/partitions_0x0_default.dtsi>

/ {
	model = "from_scratch";
	compatible = "olek,from_scratch";

	chosen {
		zephyr,sram = &sramhp;
		zephyr,console = &uart0;
		zephyr,shell-uart = &uart0;
		zephyr,flash = &flash0;
		zephyr,code-partition = &slot0_partition;
	};

};

