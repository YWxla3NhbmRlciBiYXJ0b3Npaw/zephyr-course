## app/boards/esp32c6_copy_rename/board.yml
```yaml
board:
  name: esp32c6_copy_rename
  full_name: ESP32-C6 copy rename devkitc
  vendor: Olek
  socs:
  - name: esp32c6
```

## app/boards/from_scratch/board.yml
```yaml
board:
  name: from_scratch
  full_name: from_scratch
  vendor: Olek
  socs:
  - name: esp32c6
```
